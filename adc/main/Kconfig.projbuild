## adc/main/Kconfig.projbuild
```kconfig
menu "Example Configuration"

    config DHT_GPIO
        int "DHT GPIO number"
        range 0 34
        default 15
        help
            GPIO number (IOxx) to input.
            GPIOs 35-39 are input-only so cannot be used as outputs.
    
endmenu
```
